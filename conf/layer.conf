## conf/layer.conf
```bitbake
# We have a conf and classes directory, append to BBPATH
BBPATH .= ":${LAYERDIR}"

BBFILES += "${LAYERDIR}/recipes*/*/*.bb ${LAYERDIR}/recipes*/*/*.bbappend ${LAYERDIR}/images/*.bb"

BBFILE_COLLECTIONS += "meta-flutter-rpi"
BBFILE_PATTERN_meta-flutter-rpi := "^${LAYERDIR}/"
BBFILE_PRIORITY_meta-flutter-rpi = "12"

LAYERSERIES_COMPAT_meta-flutter-rpi = "kirkstone"
```
